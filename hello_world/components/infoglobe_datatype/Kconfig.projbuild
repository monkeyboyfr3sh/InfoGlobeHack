## hello_world/main/Kconfig.projbuild
```kconfig
menu "InfoGlobe Configuration"

    config INFOGLOBE_PORT
        int "TCP Port"
        range 0 65535
        default 55555
        help
            Local TCP port the InfoGlobe server will listen on.

    config INFOGLOBE_KEEPALIVE_IDLE
        int "TCP keep-alive idle time(s)"
        default 5
        help
            Keep-alive idle time. In idle time without receiving any data from peer, will send keep-alive probe packet

    config INFOGLOBE_KEEPALIVE_INTERVAL
        int "TCP keep-alive interval time(s)"
        default 5
        help
            Keep-alive probe packet interval time.

    config INFOGLOBE_KEEPALIVE_COUNT
        int "TCP keep-alive packet retry send counts"
        default 3
        help
            Keep-alive probe packet retry count.

endmenu

menu "Wifi Configuration"

    config EXAMPLE_IPV4
        bool "IPV4"
        default y
        depends on LWIP_IPV4

    config EXAMPLE_IPV6
        bool "IPV6"
        default n
        select EXAMPLE_CONNECT_IPV6

    endmenu
```
