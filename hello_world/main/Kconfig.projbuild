## hello_world/main/Kconfig.projbuild
```kconfig
menu "InfoGlobe Configuration"

    config INFOGLOBE_PORT
        int "TCP Port"
        range 0 65535
        default 55555
        help
            Local TCP port the InfoGlobe server will listen on.

    config INFOGLOBE_KEEPALIVE_IDLE
        int "TCP keep-alive idle time(s)"
        default 5
        help
            Keep-alive idle time. In idle time without receiving any data from peer, will send keep-alive probe packet

    config INFOGLOBE_KEEPALIVE_INTERVAL
        int "TCP keep-alive interval time(s)"
        default 5
        help
            Keep-alive probe packet interval time.

    config INFOGLOBE_KEEPALIVE_COUNT
        int "TCP keep-alive packet retry send counts"
        default 3
        help
            Keep-alive probe packet retry count.

    config INFOGLOBE_TIMEZONE
        string "Time zone (POSIX TZ rule)"
        default "CST6CDT,M3.2.0,M11.1.0"
        help
            Local time zone including daylight-saving rules, so the clock
            changes automatically. Default is US Central:
            UTC-6, CDT from the 2nd Sunday of March to the 1st Sunday of
            November. Examples: "EST5EDT,M3.2.0,M11.1.0" (US Eastern),
            "MST7MDT,M3.2.0,M11.1.0" (US Mountain), "PST8PDT,M3.2.0,M11.1.0"
            (US Pacific), "MST7" (Arizona, no DST).

    menu "Hardware (ESP32-Ethernet-Kit A V1.2)"

        config INFOGLOBE_IR_LED_GPIO
            int "IR LED GPIO"
            range 0 33
            default 4
            help
                GPIO driving the 38 kHz IR LED aimed at the globe.
                Default GPIO4 is on the kit's GPIO Header 2 and is free.
                Avoid GPIO12-15 (JTAG when the DIP switches are ON),
                GPIO16/17 (PSRAM), GPIO0/5/18/19/21-23/25-27 (Ethernet)
                and GPIO34-39 (input only).

        config INFOGLOBE_BUTTON_GPIO
            int "Time-display toggle button GPIO"
            range 0 39
            default 32
            help
                Active-low button (wire it between the pin and GND) that
                toggles the clock display. Default GPIO32 is on the kit's
                GPIO Header 1 and has an internal pull-up, so leaving it
                unconnected is harmless. GPIO0 (the BOOT button) can only be
                used with Ethernet disabled: it is the Ethernet RMII clock
                input. GPIO34-39 have no internal pull-up and need an
                external one.

    endmenu

    menu "Network"

        config INFOGLOBE_WIFI_SSID
            string "Wi-Fi SSID"
            default "myssid"
            help
                Wi-Fi network to join. Wi-Fi always runs; when Ethernet is
                enabled and has a link it is preferred and Wi-Fi is the fallback.

        config INFOGLOBE_WIFI_PASSWORD
            string "Wi-Fi password"
            default "mypassword"
            help
                Leave empty for an open network.

        config INFOGLOBE_ETHERNET
            bool "Enable Ethernet (internal EMAC + IP101 PHY)"
            default y
            help
                Bring up the ESP32-Ethernet-Kit's wired port alongside Wi-Fi.
                Uses GPIO0 (RMII clock in), 5, 18, 19, 21-23 and 25-27.

        if INFOGLOBE_ETHERNET

            config INFOGLOBE_ETH_MDC_GPIO
                int "SMI MDC GPIO"
                default 23

            config INFOGLOBE_ETH_MDIO_GPIO
                int "SMI MDIO GPIO"
                default 18

            config INFOGLOBE_ETH_PHY_RST_GPIO
                int "PHY reset GPIO (-1 to disable)"
                range -1 33
                default 5

            config INFOGLOBE_ETH_PHY_ADDR
                int "PHY address"
                range 0 31
                default 1

        endif

    endmenu

endmenu
```
